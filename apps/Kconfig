## apps/examples/htu21d_demo/Kconfig
```kconfig
#
# For a description of the syntax of this configuration file,
# see the file kconfig-language.txt in the NuttX tools repository.
#


menuconfig EXAMPLE_HTU21D
	tristate "HTU21D Demo"
	default n
	depends on I2C
	select I2C_DRIVER
	---help---
		Enable support for the htu21d sensor demo.

if EXAMPLE_HTU21D

config HTU21D_DEFFREQ
	int "Default I2C frequency"
	default 100000
	---help---
		Default I2C frequency (default: 100000)

endif # EXAMPLE_HTU21D
```

## apps/examples/max30102_demo/Kconfig
```kconfig
#
# For a description of the syntax of this configuration file,
# see the file kconfig-language.txt in the NuttX tools repository.
#

config EXAMPLES_MAX30102
	tristate "\"max30102\" C++ demo"
	default n
	depends on HAVE_CXX
	---help---
		Enable the \"max30102\" C++ demo
```
